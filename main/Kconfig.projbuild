## main/Kconfig.projbuild
```kconfig
menu "MyESP32 CTRL"

    menu "Enabled Controllers"

        config ENABLE_C001_I2C
            bool "I2C"
            default y

        config ENABLE_C002_NTP
            bool "NTP"
            default y

        config ENABLE_C004_TIMERS
            bool "HW TIMERS"
            default y

        config ENABLE_C005_HUE
            bool "HUE EMULATOR"
            default y
    endmenu

    menu "Enabled Plugins"

        config ENABLE_P001_SWITCH
            bool "SWITCH"
            default y

        config ENABLE_P002_DHT
            bool "DHT11/22"
            default y

        config ENABLE_P003_BMP
            bool "BMx280"
            depends on ENABLE_C001_I2c
            default y

        config ENABLE_P004_DS18x20
            bool "DS18x20"
            default y

        config ENABLE_P005_REGULATOR
            bool "REGULATOR"
            default y

        config ENABLE_P006_ANALOG
            bool "ANALOG"
            default y

        config ENABLE_P007_ADS1115
            bool "ADS1115 IO Extender"
            default y

        config ENABLE_P008_MCP23017
            bool "MCP23017 IO Extender"
            default y

        config ENABLE_P009_PCF8574
            bool "PCF8574 IO Extender"
            default y

        config ENABLE_P010_PCA9685
            bool "PCA9685 IO Extender"
            default y

        config ENABLE_P011_MQTT
            bool "MQTT Controller"
            default y

        config ENABLE_P012_ROTARY
            bool "ROTARY ENCODER"
            default y

        config ENABLE_P013_HTTP
            bool "HTTP Controller"
            default y
    endmenu

    menu "WiFi Config"

        config WIFI_SSID
            string "WiFi SSID"
            default "myssid"
            help
                SSID (network name) for the example to connect to.

        config WIFI_PASSWORD
            string "WiFi Password"
            default "mypassword"
            help
                WiFi password (WPA or WPA2) for the example to use.
                Can be left blank if the network has no security set.

    endmenu
endmenu
```
